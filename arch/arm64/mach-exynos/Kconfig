## arch/arm64/mach-exynos/Kconfig
```kconfig
# arch/arm64/mach-exynos/Kconfig
#
# Copyright (c) 2016 Samsung Electronics Co., Ltd.
#		http://www.samsung.com/
#
# Licensed under GPLv2

# Configuration options for the EXYNOS7


menu "Samsung Exynos"

config ARCH_EXYNOS
	bool

config SOC_EXYNOS7870
	bool "Samsung EXYNOS7870"
	select ARCH_EXYNOS
	select ARCH_HAS_CPUFREQ
	select HAVE_S3C2410_I2C if I2C
	select HAVE_S3C2410_WATCHDOG if WATCHDOG
	select HAVE_S3C_RTC if RTC_CLASS
	select ARCH_SUPPORTS_MSI
	select ARM_AMBA
	select CLKSRC_OF
	select USE_OF
	select COMMON_CLK_SAMSUNG
	select CLKSRC_EXYNOS_MCT
	select PINCTRL
	select PM_GENERIC_DOMAINS if PM
	select SOC_SAMSUNG
	select SAMSUNG_DMADEV

config ARCH_EXYNOS7
	bool "SAMSUNG EXYNOS7"
	select HAVE_ARM_SCU if SMP
	select HAVE_SMP
	help
	  Samsung EXYNOS7 (A57/A53) SoC based systems

config SOC_EXYNOS8890
	bool "Samsung EXYNOS8890"
	select ARCH_EXYNOS
	select ARCH_HAS_CPUFREQ
	select HAVE_S3C2410_I2C if I2C
	select HAVE_S3C2410_WATCHDOG if WATCHDOG
	select HAVE_S3C_RTC if RTC_CLASS
	select ARCH_SUPPORTS_MSI
	select ARM_AMBA
	select CLKSRC_OF
	select USE_OF
	select COMMON_CLK_SAMSUNG
	select CLKSRC_EXYNOS_MCT
	select PINCTRL
	select PWRCAL
	select PM_GENERIC_DOMAINS if PM
	select SOC_SAMSUNG
	select SAMSUNG_DMADEV

config SOC_EXYNOS8890_EVT1
	default n
	bool "Samsung EXYNOS8890 evt1"

config ARCH_EXYNOS8
	bool "SAMSUNG EXYNOS8"
	select HAVE_ARM_SCU if SMP
	select HAVE_SMP
	help
	  Samsung EXYNOS8 (Mongoose/A53) SoC based systems

config PWRCAL
	bool "Exynos Power Chip Abstraction Layer"
	help
	 Support Power CAL for Exynos SoC.

config ARM_TRUSTZONE
	bool "Support TrustZone-enabled Trusted Execution Environment"
	default y
	help
	  Select if you want a kernel to be executed at non-secure world.
	  This option should be used with related secure bootloader and
	  TrustZone software.

	  If you don't know about TrustZone, say 'N'.
endmenu

if ARCH_EXYNOS

menu "SAMSUNG EXYNOS SoCs Support"

config SKIP_HW_BREAKPOINT
	bool "support skip hw breakpoint"
	default n
	help
	  Support early param for T32 onchip breakpoint

config SEC_BAT_AUT
	bool "Samsung TN Bat Automation Test Feature"
	default n
	help
	  Samsung TN Bat Automation Test

config SAMSUNG_PRODUCT_SHIP
	bool "set up for product shipping"
	default n	  
endmenu

endif
```
